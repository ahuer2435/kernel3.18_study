## drivers/misc/mediatek/accelerometer/KXTJ2_1009/Kconfig
```kconfig
config MTK_KXTJ2_1009
        bool "KXTJ2_1009 for MediaTek package"
        default y
	help
	  It support different accelerometer sensor.
          If this option is set,
	  it will support
          KXTJ2_1009 Accelerometer.
```

## drivers/misc/mediatek/capsensor/Kconfig
```kconfig
config CUSTOM_KERNEL_CAPSENSOR
	bool "CUSTOM_KERNEL_CAPSENSOR"
    default n
	help
	  Kernel space activity sensor driver.
```
